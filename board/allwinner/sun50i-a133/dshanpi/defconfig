## package/libnotify/Config.in
```kconfig
config BR2_PACKAGE_LIBNOTIFY
    bool "libnotify"
    select BR2_PACKAGE_GDK_PIXBUF
    select BR2_PACKAGE_LIBGTK2
    select BR2_PACKAGE_LIBGTK3
    select BR2_PACKAGE_LIBGTK3_WAYLAND
    select BR2_PACKAGE_LIBGTK3_X11
    select BR2_PACKAGE_PYTHON3
    select BR2_PACKAGE_GOBJECT_INTROSPECTION
```

## package/mame/Config.in
```kconfig
menuconfig BR2_PACKAGE_MAME
	bool "mame"
	depends on BR2_PACKAGE_RETROARCH
	help
	  libretro implementation of mame
```

## package/moonlight/Config.in
```kconfig
menuconfig BR2_PACKAGE_MOONLIGHT
    bool "moonlight"
    select BR2_PACKAGE_OPUS
    select BR2_PACKAGE_LIBEVDEV
    select BR2_PACKAGE_LIBCURL
    select BR2_PACKAGE_EXPAT
    select BR2_PACKAGE_DBUS
    select BR2_PACKAGE_AVAHI
    select BR2_PACKAGE_SPIRV_HEADERS
    select BR2_PACKAGE_VULKAN_HEADERS

if BR2_PACKAGE_MOONLIGHT
config BR2_PACKAGE_MOONLIGHT_SDL
    bool "Enable SDL Support"
    default y
    select BR2_PACKAGE_SDL2
    select BR2_PACKAGE_SDL2_GFX
    select BR2_PACKAGE_SDL2_IMAGE
    select BR2_PACKAGE_SDL2_MIXER
    select BR2_PACKAGE_SDL2_NET
    select BR2_PACKAGE_SDL2_TTF

config BR2_PACKAGE_MOONLIGHT_FFMPEG
    bool "Enable ffmpeg Support"
    default y
    select BR2_PACKAGE_FFMPEG

config BR2_PACKAGE_MOONLIGHT_X11
    bool "Enable X11 Support"
    default y
    select BR2_PACKAGE_XORG7
    select BR2_PACKAGE_XLIB_LIBX11
    select BR2_PACKAGE_XLIB_LIBXEXT

config BR2_PACKAGE_MOONLIGHT_PULSE
    bool "Enable PulseAudio Support"
    default y
    select BR2_PACKAGE_PULSEAUDIO

config BR2_PACKAGE_MOONLIGHT_CEC
    bool "Enable CEC Support"
    default y 
    select BR2_PACKAGE_LIBCEC

endif
```

## package/sunshine/Config.in
```kconfig
menuconfig BR2_PACKAGE_SUNSHINE
    bool "sunshine"
    select BR2_PACKAGE_BOOST
    select BR2_PACKAGE_BOOST_ATOMIC
    select BR2_PACKAGE_BOOST_CONTEXT
    select BR2_PACKAGE_BOOST_DATE_TIME
    select BR2_PACKAGE_BOOST_FILESYSTEM
    select BR2_PACKAGE_LIBCURL
    select BR2_PACKAGE_LIBMINIUPNPC
    select BR2_PACKAGE_FFMPEG
    select BR2_PACKAGE_WAYLAND
    select BR2_PACKAGE_WAYLAND_PROTOCOLS

if BR2_PACKAGE_SUNSHINE

config BR2_PACKAGE_SUNSHINE_USE_STATIC_BOOST
    bool "Use static Boost"
    default n

config BR2_PACKAGE_SUNSHINE_BUILD_APPIMAGE
    bool "Build App Image"
    default n

config BR2_PACKAGE_SUNSHINE_BUILD_FLATPAK
    bool "Build Flat PAK"
    default n

config BR2_PACKAGE_SUNSHINE_CONFIGURE_PKGBUILD
    bool "Configure files required for AUR."
    default n

config BR2_PACKAGE_SUNSHINE_ENABLE_CUDA
    bool "Enable cuda specific code"
    default n

config BR2_PACKAGE_SUNSHINE_ENABLE_DRM
    bool "Enable KMS grab if available"
    default y

config BR2_PACKAGE_SUNSHINE_ENABLE_VAAPI
    bool "Enable building vaapi specific code"
    default n

config BR2_PACKAGE_SUNSHINE_ENABLE_WAYLAND
    bool "Enable building wayland specific code"
    default y

config BR2_PACKAGE_SUNSHINE_ENABLE_X11
    bool "Enable X11 grab if available"
    default y
    
endif
```
